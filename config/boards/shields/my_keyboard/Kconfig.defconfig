## config/boards/shields/my_keyboard/Kconfig.defconfig
```kconfig
if SHIELD_MY_KEYBOARD

config ZMK_KEYBOARD_NAME
    default "my_keyboard"

endif
```

## config/boards/shields/my_keyboard/Kconfig.shield
```kconfig
config SHIELD_MY_KEYBOARD
    def_bool $(shields_list_contains,my_keyboard)
    select ZMK_BOARD_COMPAT
```

## config/dts/bindings/zmk,kscan-duplex.yaml
```yaml
description: Duplex Matrix Kscan Driver
compatible: "zmk,kscan-duplex"
include: base.yaml

properties:
  row-gpios:
    type: phandle-array
    required: true
  col-gpios:
    type: phandle-array
    required: true
```
