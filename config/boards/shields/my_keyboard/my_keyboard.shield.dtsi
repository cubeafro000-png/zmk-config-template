#include <dt-bindings/zmk/matrix_transform.h>

/ {
    chosen {
        zmk,kscan = &kscan0;
        zmk,matrix-transform = &default_transform;
    };

    /* 物理5行×6列 と kscanマトリクス（行0〜4, 列0〜2）のマッピング */
    default_transform: matrix_transform {
        compatible = "zmk,matrix-transform";
        columns = <6>;
        rows = <5>;

        bindings = <
            /* 1段目 (SW1〜SW6)   : Row0 (col0,1,2) / Row0 (col0,1,2) */
            RC(0,0) RC(0,1) RC(0,2)   RC(0,0) RC(0,1) RC(0,2)

            /* 2段目 (SW7〜SW12)  : Row1 (col0,1,2) / Row1 (col0,1,2) */
            RC(1,0) RC(1,1) RC(1,2)   RC(1,0) RC(1,1) RC(1,2)

            /* 3段目 (SW13〜SW18) : Row2 (col0,1,2) / Row2 (col0,1,2) */
            RC(2,0) RC(2,1) RC(2,2)   RC(2,0) RC(2,1) RC(2,2)

            /* 4段目 (SW19〜SW24) : Row3 (col0,1,2) / Row3 (col0,1,2) */
            RC(3,0) RC(3,1) RC(3,2)   RC(3,0) RC(3,1) RC(3,2)

            /* 5段目 (SW25〜SW30) : Row4 (col0,1,2) / Row4 (col0,1,2) */
            RC(4,0) RC(4,1) RC(4,2)   RC(4,0) RC(4,1) RC(4,2)
        >;
    };

    kscan0: kscan {
        compatible = "zmk,kscan-gpio-matrix";
        diode-direction = "col2row";

        /* 行 (Row 0 〜 Row 4) のピン割り当て */
        row-gpios = <&xiao_d 0 (GPIO_ACTIVE_HIGH | GPIO_PULL_DOWN)>,
                    <&xiao_d 1 (GPIO_ACTIVE_HIGH | GPIO_PULL_DOWN)>,
                    <&xiao_d 2 (GPIO_ACTIVE_HIGH | GPIO_PULL_DOWN)>,
                    <&xiao_d 3 (GPIO_ACTIVE_HIGH | GPIO_PULL_DOWN)>,
                    <&xiao_d 10 (GPIO_ACTIVE_HIGH | GPIO_PULL_DOWN)>;

        /* 列 (Col 0 〜 Col 2) のピン割り当て */
        col-gpios = <&xiao_d 9 GPIO_ACTIVE_HIGH>,
                    <&xiao_d 7 GPIO_ACTIVE_HIGH>,
                    <&xiao_d 6 GPIO_ACTIVE_HIGH>;
    };
};
